## conf/bblayers.conf.sample
```bitbake
# POKY_BBLAYERS_CONF_VERSION is increased each time build/conf/bblayers.conf
# changes incompatibly
POKY_BBLAYERS_CONF_VERSION = "2"

BBPATH = "${TOPDIR}"
BBFILES ?= ""

BBLAYERS ?= " \
  ##OEROOT##/meta \
  ##OEROOT##/meta-poky \
  ##OEROOT##/meta-yocto-bsp \
  ##OEROOT##/../meta-openembedded/meta-oe \
  ##OEROOT##/../meta-openembedded/meta-python \
  ##OEROOT##/../meta-openembedded/meta-networking \
  ##OEROOT##/../meta-openembedded/meta-filesystems \
  ##OEROOT##/../meta-virtualization \
  ##OEROOT##/../meta-intel \
  ##OEROOT##/../meta-intel-realsense \
  ##OEROOT##/../meta-intel-aero-base \
  ##OEROOT##/../meta-intel-aero \
  "
```

## conf/distro/poky-aero.conf
```bitbake
require conf/distro/poky.conf

POKY_VERSION := "${DISTRO_VERSION}"
DISTRO = "poky-aero"
DISTRO_NAME = "Poky Aero (Intel Aero Linux Distro)"
DISTRO_VERSION = "1.6.0-dev"
DISTRO_FEATURES_DEFAULT_remove = "3g"

DISTRO_FEATURES += "aufs"
DISTRO_FEATURES += "systemd"
# cockpit requires pam
DISTRO_FEATURES += "pam"

VIRTUAL-RUNTIME_init_manager = "systemd"
DISTRO_FEATURES_BACKFILL_CONSIDERED = "sysvinit"
VIRTUAL-RUNTIME_initscripts = "systemd-compat-units"
VIRTUAL-RUNTIME_syslog = ""
PREFERRED_PROVIDER[iasl-native] = "acpica-native"
BBMASK += " meta-virtualization/recipes-extended/iasl"
```

## conf/layer.conf
```bitbake
# We have a conf and classes directory, add to BBPATH
BBPATH .= ":${LAYERDIR}"

# We have recipes-* directories, add to BBFILES
BBFILES += "${LAYERDIR}/recipes-*/*/*.bb \
            ${LAYERDIR}/recipes-*/*/*.bbappend"

BBFILE_COLLECTIONS += "intelaero"
BBFILE_PATTERN_intelaero = "^${LAYERDIR}/"
BBFILE_PRIORITY_intelaero = "7"
LAYERVERSION_intelaero = "0"
BBFILE_PRIORITY_librealsense = "8"
```

## conf/machine/intel-aero.conf
```bitbake
#@TYPE: Machine
#@NAME: Intel Aero.

#@DESCRIPTION: Machine configuration for Intel Aero Platform.
#Based on intel-corei7-64

require conf/machine/intel-corei7-64.conf

MACHINE_EXTRA_RDEPENDS += "kernel-firmware-shisp-2401a0-v21"
MACHINE_EXTRA_RRECOMMENDS += "spidev"
KERNEL_MODULE_AUTOLOAD += "spi_imu spi_fpga spi_can"
LABELS_LIVE = "install boot"
```
